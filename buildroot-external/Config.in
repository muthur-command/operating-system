## buildroot-external/Config.in
```kconfig
source "$BR2_EXTERNAL_MCOS_PATH/package/bluetooth-rtl8723/Config.in"
source "$BR2_EXTERNAL_MCOS_PATH/package/eq3_char_loop/Config.in"
source "$BR2_EXTERNAL_MCOS_PATH/package/gasket/Config.in"
source "$BR2_EXTERNAL_MCOS_PATH/package/generic_raw_uart/Config.in"
source "$BR2_EXTERNAL_MCOS_PATH/package/hailo8-firmware/Config.in"
source "$BR2_EXTERNAL_MCOS_PATH/package/hailo-pci/Config.in"
source "$BR2_EXTERNAL_MCOS_PATH/package/hardkernel-boot/Config.in"
source "$BR2_EXTERNAL_MCOS_PATH/package/mcos-containers/Config.in"
source "$BR2_EXTERNAL_MCOS_PATH/package/khadas-boot/Config.in"
source "$BR2_EXTERNAL_MCOS_PATH/package/os-agent/Config.in"
source "$BR2_EXTERNAL_MCOS_PATH/package/pi-bluetooth/Config.in"
source "$BR2_EXTERNAL_MCOS_PATH/package/qemu-guest-agent/Config.in"
source "$BR2_EXTERNAL_MCOS_PATH/package/lxd-guest-agent/Config.in"
source "$BR2_EXTERNAL_MCOS_PATH/package/rockchip-blobs/Config.in"
source "$BR2_EXTERNAL_MCOS_PATH/package/rockchip-mpp/Config.in"
source "$BR2_EXTERNAL_MCOS_PATH/package/rockchip-mali-sdk/Config.in"
source "$BR2_EXTERNAL_MCOS_PATH/package/rockchip-rga/Config.in"
source "$BR2_EXTERNAL_MCOS_PATH/package/rknpu2/Config.in"
source "$BR2_EXTERNAL_MCOS_PATH/package/gstreamer1-rockchip/Config.in"
source "$BR2_EXTERNAL_MCOS_PATH/package/rockchip-alsa-config/Config.in"
source "$BR2_EXTERNAL_MCOS_PATH/package/skwifi/Config.in"
source "$BR2_EXTERNAL_MCOS_PATH/package/rpi-eeprom/Config.in"
source "$BR2_EXTERNAL_MCOS_PATH/package/rpi-rf-mod/Config.in"
source "$BR2_EXTERNAL_MCOS_PATH/package/rtl88x2bu/Config.in"
source "$BR2_EXTERNAL_MCOS_PATH/package/tempio/Config.in.host"
source "$BR2_EXTERNAL_MCOS_PATH/package/udisks2/Config.in"
source "$BR2_EXTERNAL_MCOS_PATH/package/vcgencmd/Config.in"
source "$BR2_EXTERNAL_MCOS_PATH/package/xe-guest-utilities/Config.in"
```

## buildroot-external/board/neardi/lb200/boot.its
```
/dts-v1/;

/ {
	description = "MCOS Neardi LB200 Linux FIT image";
	#address-cells = <1>;

	images {
		kernel {
			data = /incbin/("@KERNEL_IMG@");
			type = "kernel";
			arch = "arm64";
			os = "linux";
			compression = "none";
			load = <0x42000000>;
			entry = <0x42000000>;

			hash {
				algo = "sha256";
			};
		};

		fdt {
			data = /incbin/("@KERNEL_DTB@");
			type = "flat_dt";
			arch = "arm64";
			compression = "none";
			load = <0x52000000>;

			hash {
				algo = "sha256";
			};
		};
	};

	configurations {
		default = "conf";

		conf {
			description = "MCOS LB200";
			kernel = "kernel";
			fdt = "fdt";
		};
	};
};
```

## buildroot-external/configs/mc_neardi_lb200_defconfig
```kconfig
# Buildroot defconfig for Neardi RK3576 LB200 Board
# Based on odroid_m1_defconfig, adapted for RK3576

BR2_aarch64=y
BR2_PACKAGE_HOST_LINUX_HEADERS_CUSTOM_6_12=y
BR2_TOOLCHAIN_BUILDROOT_CXX=y
BR2_DL_DIR="$(TOPDIR)/dl"
BR2_CCACHE=y
BR2_CCACHE_DIR="$(HOME)/.buildroot-ccache"
BR2_ENABLE_LTO=y
BR2_GLOBAL_PATCH_DIR="$(BR2_EXTERNAL_MCOS_PATH)/patches $(BR2_EXTERNAL_MCOS_PATH)/board/neardi/lb200/patches"
BR2_SSP_REGULAR=y
BR2_TARGET_GENERIC_HOSTNAME="mcos"
BR2_TARGET_GENERIC_ISSUE="Welcome to Muthur Command OS"
BR2_INIT_SYSTEMD=y
# BR2_TARGET_GENERIC_REMOUNT_ROOTFS_RW is not set
BR2_TARGET_LOCALTIME="Etc/UTC"
BR2_ROOTFS_OVERLAY="$(BR2_EXTERNAL_MCOS_PATH)/rootfs-overlay"
BR2_ROOTFS_POST_BUILD_SCRIPT="$(BR2_EXTERNAL_MCOS_PATH)/scripts/post-build.sh"
BR2_ROOTFS_POST_IMAGE_SCRIPT="$(BR2_EXTERNAL_MCOS_PATH)/scripts/post-image.sh"
BR2_ROOTFS_POST_SCRIPT_ARGS="$(BR2_EXTERNAL_MCOS_PATH)/board/neardi/lb200 $(BR2_EXTERNAL_MCOS_PATH)/board/neardi/lb200/mcos-hook.sh"

# Linux Kernel
BR2_LINUX_KERNEL=y
# YT8521 PHY: board DTS uses MDIO reg = <0x0> (rk3576-neardi-lb200-gmac.dtsi).
# Upstream motorcomm.c in 6.18.x does not need a driver patch.
BR2_LINUX_KERNEL_CUSTOM_VERSION=y
BR2_LINUX_KERNEL_CUSTOM_VERSION_VALUE="6.18.29"
BR2_LINUX_KERNEL_USE_CUSTOM_CONFIG=y
BR2_LINUX_KERNEL_CUSTOM_CONFIG_FILE="$(BR2_EXTERNAL_MCOS_PATH)/kernel/v6.18.y/kernel-arm64-rockchip.config"
BR2_LINUX_KERNEL_CONFIG_FRAGMENT_FILES="$(BR2_EXTERNAL_MCOS_PATH)/kernel/v6.18.y/mcos.config $(BR2_EXTERNAL_MCOS_PATH)/kernel/v6.18.y/docker.config $(BR2_EXTERNAL_MCOS_PATH)/kernel/v6.18.y/device-support.config $(BR2_EXTERNAL_MCOS_PATH)/kernel/v6.18.y/device-support-wireless.config $(BR2_EXTERNAL_MCOS_PATH)/board/neardi/lb200/kernel.config"
BR2_LINUX_KERNEL_LZ4=y
BR2_LINUX_KERNEL_DTS_SUPPORT=y
BR2_LINUX_KERNEL_INTREE_DTS_NAME="rockchip/rk3576-mc-neardi-lb200"
BR2_LINUX_KERNEL_DTB_OVERLAY_SUPPORT=y
BR2_LINUX_KERNEL_NEEDS_HOST_OPENSSL=y
BR2_LINUX_KERNEL_NEEDS_HOST_LIBELF=y

# BusyBox
BR2_PACKAGE_BUSYBOX_CONFIG="$(BR2_EXTERNAL_MCOS_PATH)/busybox.config"
BR2_PACKAGE_BUSYBOX_INDIVIDUAL_BINARIES=y

# Storage and filesystem tools
BR2_PACKAGE_V4L2LOOPBACK=y
BR2_PACKAGE_PIGZ=y
BR2_PACKAGE_JQ=y
BR2_PACKAGE_CIFS_UTILS=y
BR2_PACKAGE_DOSFSTOOLS=y
BR2_PACKAGE_DOSFSTOOLS_FSCK_FAT=y
BR2_PACKAGE_E2FSPROGS=y
BR2_PACKAGE_E2FSPROGS_E2IMAGE=y
BR2_PACKAGE_E2FSPROGS_RESIZE2FS=y
BR2_PACKAGE_NFS_UTILS=y

# Linux Firmware (standard WiFi/BT firmware)
BR2_PACKAGE_LINUX_FIRMWARE=y
BR2_PACKAGE_LINUX_FIRMWARE_MEDIATEK_MT7921_BT=y
BR2_PACKAGE_LINUX_FIRMWARE_MEDIATEK_MT7922_BT=y
BR2_PACKAGE_LINUX_FIRMWARE_QUALCOMM_6174A_BT=y
BR2_PACKAGE_LINUX_FIRMWARE_RTL_87XX_BT=y
BR2_PACKAGE_LINUX_FIRMWARE_RTL_88XX_BT=y
BR2_PACKAGE_LINUX_FIRMWARE_ATHEROS_6003=y
BR2_PACKAGE_LINUX_FIRMWARE_ATHEROS_6004=y
BR2_PACKAGE_LINUX_FIRMWARE_ATHEROS_7010=y
BR2_PACKAGE_LINUX_FIRMWARE_ATHEROS_9170=y
BR2_PACKAGE_LINUX_FIRMWARE_ATHEROS_9271=y
BR2_PACKAGE_LINUX_FIRMWARE_BRCM_BCM43XX=y
BR2_PACKAGE_LINUX_FIRMWARE_BRCM_BCM43XXX=y
BR2_PACKAGE_LINUX_FIRMWARE_MWIFIEX_SD8787=y
BR2_PACKAGE_LINUX_FIRMWARE_MWIFIEX_SD8797=y
BR2_PACKAGE_LINUX_FIRMWARE_MWIFIEX_USB8797=y
BR2_PACKAGE_LINUX_FIRMWARE_MWIFIEX_USB8801=y
BR2_PACKAGE_LINUX_FIRMWARE_MWIFIEX_SD8887=y
BR2_PACKAGE_LINUX_FIRMWARE_MWIFIEX_SD8897=y
BR2_PACKAGE_LINUX_FIRMWARE_MWIFIEX_USB8897=y
BR2_PACKAGE_LINUX_FIRMWARE_MEDIATEK_MT7601U=y
BR2_PACKAGE_LINUX_FIRMWARE_MEDIATEK_MT7610E=y
BR2_PACKAGE_LINUX_FIRMWARE_MEDIATEK_MT76X2E=y
BR2_PACKAGE_LINUX_FIRMWARE_MEDIATEK_MT7921=y
BR2_PACKAGE_LINUX_FIRMWARE_MEDIATEK_MT7922=y
BR2_PACKAGE_LINUX_FIRMWARE_RALINK_RT73=y
BR2_PACKAGE_LINUX_FIRMWARE_RALINK_RT2XX=y
BR2_PACKAGE_LINUX_FIRMWARE_RTL_81XX=y
BR2_PACKAGE_LINUX_FIRMWARE_RTL_87XX=y
BR2_PACKAGE_LINUX_FIRMWARE_RTL_RTW88=y
BR2_PACKAGE_LINUX_FIRMWARE_RTL_RTW89=y
BR2_PACKAGE_LINUX_FIRMWARE_RTL_815X=y
BR2_PACKAGE_LINUX_FIRMWARE_USB_SERIAL_TI=y

# Seekwave WiFi/BT (SV6160) driver
BR2_PACKAGE_SKWIFI=y
BR2_PACKAGE_SKWIFI_FIRMWARE=y

# Network and connectivity
BR2_PACKAGE_DBUS_BROKER=y
BR2_PACKAGE_GPTFDISK=y
BR2_PACKAGE_GPTFDISK_SGDISK=y
BR2_PACKAGE_RTL8821CU=y
BR2_PACKAGE_USB_MODESWITCH_DATA=y
BR2_PACKAGE_CA_CERTIFICATES=y
BR2_PACKAGE_LIBCURL_CURL=y
BR2_PACKAGE_LIBDNET=y
BR2_PACKAGE_LIBCGROUP=y
BR2_PACKAGE_LIBCGROUP_TOOLS=y
BR2_PACKAGE_BLUEZ5_UTILS=y
BR2_PACKAGE_BLUEZ5_UTILS_CLIENT=y
BR2_PACKAGE_BLUEZ5_UTILS_TOOLS=y
BR2_PACKAGE_BLUEZ5_UTILS_DEPRECATED=y
BR2_PACKAGE_BLUEZ5_UTILS_PLUGINS_AUDIO=y
BR2_PACKAGE_BLUEZ5_UTILS_PLUGINS_HID=y
BR2_PACKAGE_DHCP=y
BR2_PACKAGE_DHCP_CLIENT=y
BR2_PACKAGE_DROPBEAR=y
BR2_PACKAGE_DROPBEAR_DISABLE_REVERSEDNS=y
# BR2_PACKAGE_IFUPDOWN_SCRIPTS is not set
BR2_PACKAGE_IPROUTE2=y
BR2_PACKAGE_ETHTOOL=y
BR2_PACKAGE_IPTABLES_NFTABLES=y
BR2_PACKAGE_IPTABLES_NFTABLES_DEFAULT=y
# BR2_PACKAGE_NETWORK_MANAGER is not set
# BR2_PACKAGE_NETWORK_MANAGER_CLI is not set
BR2_PACKAGE_RPCBIND=y
BR2_PACKAGE_WIRELESS_REGDB=y
BR2_PACKAGE_WPA_SUPPLICANT=y
BR2_PACKAGE_WPA_SUPPLICANT_WEXT=y
BR2_PACKAGE_WPA_SUPPLICANT_AP_SUPPORT=y
BR2_PACKAGE_WPA_SUPPLICANT_WPA3=y
BR2_PACKAGE_WPA_SUPPLICANT_DBUS=y
BR2_PACKAGE_WPA_SUPPLICANT_DBUS_INTROSPECTION=y

# Security
BR2_PACKAGE_APPARMOR=y
BR2_PACKAGE_APPARMOR_PROFILES=y

# Containers and virtualization
BR2_PACKAGE_TINI=y
BR2_PACKAGE_DOCKER_CLI=y
BR2_PACKAGE_DOCKER_ENGINE=y

# System tools (Rockchip updateEngine OTA — LB200 only)
BR2_PACKAGE_PROCPS_NG=y
BR2_PACKAGE_ROCKCHIP_RECOVERY=y
BR2_PACKAGE_ROCKCHIP_RECOVERY_BOOTCONTROL=y
BR2_PACKAGE_ROCKCHIP_RECOVERY_UPDATEENGINE=y
BR2_PACKAGE_ROCKCHIP_RECOVERY_SUCCESSFUL_BOOT=y
BR2_PACKAGE_USBMOUNT=y
# BR2_PACKAGE_RAUC is not set

# Systemd components
BR2_PACKAGE_SYSTEMD_JOURNAL_REMOTE=y
BR2_PACKAGE_SYSTEMD_COREDUMP=y
# BR2_PACKAGE_SYSTEMD_HWDB is not set
BR2_PACKAGE_SYSTEMD_LOCALED=y
BR2_PACKAGE_SYSTEMD_LOGIND=y
# BR2_PACKAGE_SYSTEMD_NETWORKD is not set
# BR2_PACKAGE_SYSTEMD_RESOLVED is not set
BR2_PACKAGE_SYSTEMD_RANDOMSEED=y
BR2_PACKAGE_UTIL_LINUX_LOGIN=y
BR2_PACKAGE_UTIL_LINUX_NOLOGIN=y
BR2_PACKAGE_UTIL_LINUX_PARTX=y
BR2_PACKAGE_UTIL_LINUX_ZRAMCTL=y
BR2_PACKAGE_AUDIT=y

# Rootfs configuration (ext4 for Rockchip system_a/b slots)
BR2_TARGET_ROOTFS_EXT2=y
BR2_TARGET_ROOTFS_EXT2_4=y
BR2_TARGET_ROOTFS_EXT2_SIZE="2048M"
# BR2_TARGET_ROOTFS_EROFS is not set
# BR2_TARGET_ROOTFS_TAR is not set

# U-Boot
BR2_TARGET_UBOOT=y
BR2_TARGET_UBOOT_BUILD_SYSTEM_KCONFIG=y
BR2_TARGET_UBOOT_CUSTOM_VERSION=y
BR2_TARGET_UBOOT_CUSTOM_VERSION_VALUE="2026.04"
BR2_TARGET_UBOOT_BOARD_DEFCONFIG="mc-neardi-lb200-rk3576"
BR2_TARGET_UBOOT_CONFIG_FRAGMENT_FILES="$(BR2_EXTERNAL_MCOS_PATH)/bootloader/uboot.config $(BR2_EXTERNAL_MCOS_PATH)/board/neardi/lb200/uboot.config"
BR2_TARGET_UBOOT_NEEDS_PYLIBFDT=y
BR2_TARGET_UBOOT_NEEDS_PYELFTOOLS=y
BR2_TARGET_UBOOT_NEEDS_ATF_BL31=y
BR2_TARGET_UBOOT_NEEDS_ATF_BL31_ELF=y
BR2_TARGET_UBOOT_NEEDS_TPL=y
BR2_TARGET_UBOOT_FORMAT_CUSTOM=y
BR2_TARGET_UBOOT_FORMAT_CUSTOM_NAME="u-boot-rockchip.bin"
# BR2_PACKAGE_HOST_UBOOT_TOOLS_BOOT_SCRIPT is not set

# Host tools
BR2_PACKAGE_HOST_DOSFSTOOLS=y
BR2_PACKAGE_HOST_E2FSPROGS=y
BR2_PACKAGE_HOST_GENIMAGE=y
BR2_PACKAGE_HOST_GPTFDISK=y
BR2_PACKAGE_HOST_MTOOLS=y
BR2_PACKAGE_HOST_ROCKCHIP_PACK=y
# BR2_PACKAGE_HOST_RAUC is not set
BR2_PACKAGE_HOST_UBOOT_TOOLS=y
BR2_PACKAGE_HOST_UBOOT_TOOLS_FIT_SUPPORT=y

# MCiOS specific packages
BR2_PACKAGE_GASKET=y
BR2_PACKAGE_MCOS_CONTAINERS=y
BR2_PACKAGE_MCOS_CONTAINERS_ARCH="aarch64"
BR2_PACKAGE_MCOS_CONTAINERS_MACHINE="mc-neardi-lb200"
BR2_PACKAGE_MCOS_CONTAINERS_CHANNEL_DEV=y
BR2_PACKAGE_MCIO=y
BR2_PACKAGE_MCIO_ARCH="aarch64"
BR2_PACKAGE_MCIO_MACHINE="mc-neardi-lb200"
BR2_PACKAGE_OS_AGENT=y
BR2_PACKAGE_OS_AGENT_BOARD="McNeardiLB200"
BR2_PACKAGE_UDISKS2=y

# Rockchip specific
BR2_PACKAGE_ROCKCHIP_BLOBS=y
BR2_PACKAGE_ROCKCHIP_BLOBS_VERSION="ecb4fcbe954edf38b3ae037d5de6d9f5bccf81f4"
BR2_PACKAGE_ROCKCHIP_BLOBS_ATF="bin/rk35/rk3576_bl31_v1.24.elf"
BR2_PACKAGE_ROCKCHIP_BLOBS_TEE="bin/rk35/rk3576_bl32_v1.08.bin"
BR2_PACKAGE_ROCKCHIP_BLOBS_TPL="bin/rk35/rk3576_ddr_lp4_2112MHz_lp5_2736MHz_v1.12.bin"

# Rockchip multimedia packages
BR2_PACKAGE_GSTREAMER1=y
BR2_PACKAGE_GST1_PLUGINS_BASE=y
BR2_PACKAGE_ROCKCHIP_MPP=y
BR2_PACKAGE_ROCKCHIP_MPP_ALLOCATOR_DRM=y
BR2_PACKAGE_ROCKCHIP_MALI_SDK=y
BR2_PACKAGE_ROCKCHIP_MALI_SDK_HAS_EGL=y
BR2_PACKAGE_ROCKCHIP_MALI_SDK_HAS_GLES=y
BR2_PACKAGE_ROCKCHIP_MALI_SDK_HAS_OPENCL=y
BR2_PACKAGE_ROCKCHIP_MALI_SDK_HAS_GBM=y
BR2_PACKAGE_ROCKCHIP_RGA=y
BR2_PACKAGE_RKNPU2=y
BR2_PACKAGE_RKNPU2_ARCH="aarch64"
BR2_PACKAGE_GSTREAMER1_ROCKCHIP=y
BR2_PREFER_ROCKCHIP_RGA=y
BR2_PACKAGE_ROCKCHIP_ALSA_CONFIG=y
BR2_ROCKCHIP_ALSA_CONFIG_INSTALL_INIT_SCRIPT=y

# WiFi packages (SKW driver will be built as module via kernel patch)
BR2_PACKAGE_RTL88X2BU=y

# Additional host tools
BR2_PACKAGE_HOST_TEMPIO=y
```

## buildroot-external/package/gstreamer1-rockchip/Config.in
```kconfig
config BR2_PACKAGE_GSTREAMER1_ROCKCHIP
	bool "gstreamer1-rockchip"
	select BR2_PACKAGE_GST1_PLUGINS_BASE
	select BR2_PACKAGE_ROCKCHIP_MPP
	help
	  GStreamer plugins for Rockchip hardware acceleration.
	  This package provides GStreamer elements for MPP-based
	  video encoding/decoding and RGA-based image processing.

	  https://github.com/rockchip-linux/gstreamer-rockchip

config BR2_PREFER_ROCKCHIP_RGA
	bool "Enable RGA plugin"
	default y
	depends on BR2_PACKAGE_GSTREAMER1_ROCKCHIP
	select BR2_PACKAGE_ROCKCHIP_RGA
	help
	  Enable the RGA (Raster Graphic Acceleration) GStreamer
	  plugin.
```

## buildroot-external/package/hassio/Config.in
```kconfig
menuconfig BR2_PACKAGE_HASSIO
	bool "Supervisor App"
	help
	  This is the Application layer they build the
	  data partition with configurations.

	  https://github.com/muthur-command/supervisor

if BR2_PACKAGE_HASSIO

config BR2_PACKAGE_HASSIO_ARCH
	string "Supervisor Arch"
	help
	  Supervisor architecture which should be pull.

config BR2_PACKAGE_HASSIO_MACHINE
	string "Supervisor Machine"
	help
	  Machine id used when resolving images from version.json.

choice
	prompt "Default Channel"
	default BR2_PACKAGE_HASSIO_CHANNEL_STABLE
	help
	  Channel to use by default.

config BR2_PACKAGE_HASSIO_CHANNEL_STABLE
	bool "Stable"
	help
	  Stable channel.

config BR2_PACKAGE_HASSIO_CHANNEL_BETA
	bool "Beta"
	help
	  Beta channel.

config BR2_PACKAGE_HASSIO_CHANNEL_DEV
	bool "Dev"
	help
	  Dev channel.

endchoice

endif
```

## buildroot-external/package/mcos-containers/Config.in
```kconfig
menuconfig BR2_PACKAGE_MCOS_CONTAINERS
	bool "Supervisor App"
	help
	  This is the Application layer they build the
	  data partition with configurations.

	  https://github.com/muthur-command/supervisor

if BR2_PACKAGE_MCOS_CONTAINERS

config BR2_PACKAGE_MCOS_CONTAINERS_ARCH
	string "Supervisor Arch"
	help
	  Supervisor architecture which should be pull.

config BR2_PACKAGE_MCOS_CONTAINERS_MACHINE
	string "Supervisor Machine"
	help
	  Machine id used when resolving images from version.json.

choice
	prompt "Default Channel"
	default BR2_PACKAGE_MCOS_CONTAINERS_CHANNEL_STABLE
	help
	  Channel to use by default.

config BR2_PACKAGE_MCOS_CONTAINERS_CHANNEL_STABLE
	bool "Stable"
	help
	  Stable channel.

config BR2_PACKAGE_MCOS_CONTAINERS_CHANNEL_BETA
	bool "Beta"
	help
	  Beta channel.

config BR2_PACKAGE_MCOS_CONTAINERS_CHANNEL_DEV
	bool "Dev"
	help
	  Dev channel.

endchoice

endif
```

## buildroot-external/package/os-agent/Config.in
```kconfig
config BR2_PACKAGE_OS_AGENT
	bool "Muthur Command OS Agent"
	help
	  Install the Muthur Command OS Agent (D-Bus host agent for Supervisor)

if BR2_PACKAGE_OS_AGENT

config BR2_PACKAGE_OS_AGENT_BOARD
	string "OS-Agent board"
	help
	  OS Agent board feature which should be pull.

endif
```

## buildroot-external/package/rknpu2/Config.in
```kconfig
config BR2_PACKAGE_RKNPU2
	bool "rknpu2"
	help
	  Rockchip NPU (Neural Processing Unit) driver and runtime.
	  This package provides the RKNN API for NPU inference on
	  Rockchip SoCs (RK3576, RK3588, etc.).

	  https://github.com/rockchip-linux/rknpu2

config BR2_PACKAGE_RKNPU2_ARCH
	string "NPU architecture"
	default "aarch64"
	depends on BR2_PACKAGE_RKNPU2
	help
	  Target architecture for NPU runtime.
	  Options: aarch64, armhf

config BR2_PACKAGE_RKNPU2_EXAMPLE
	bool "Install NPU example"
	default n
	depends on BR2_PACKAGE_RKNPU2
	help
	  Install the RKNN common test example.
```

## buildroot-external/package/rockchip-alsa-config/Config.in
```kconfig
config BR2_PACKAGE_ROCKCHIP_ALSA_CONFIG
	bool "rockchip-alsa-config"
	help
	  ALSA configuration files for Rockchip boards.
	  This package provides ALSA mixer configurations and
	  audio routing settings for Rockchip SoCs.

config BR2_ROCKCHIP_ALSA_CONFIG_INSTALL_INIT_SCRIPT
	bool "Install init script"
	default y
	depends on BR2_PACKAGE_ROCKCHIP_ALSA_CONFIG
	help
	  Install the ALSA configuration init script.
```

## buildroot-external/package/rockchip-blobs/Config.in
```kconfig
config BR2_PACKAGE_ROCKCHIP_BLOBS
	bool "Rockchip loader binaries"
	help
	  Rockchip loader binaries (required by U-Boot)

if BR2_PACKAGE_ROCKCHIP_BLOBS

config BR2_PACKAGE_ROCKCHIP_BLOBS_VERSION
	string "Git hash version of rkbin"

config BR2_PACKAGE_ROCKCHIP_BLOBS_ATF
	string "ARM Trusted Firmware file"
	help
	  ARM Trusted Firmware file

config BR2_PACKAGE_ROCKCHIP_BLOBS_TPL
	string "Rockchip TPL file"
	help
	  Rockchip TPL file

config BR2_PACKAGE_ROCKCHIP_BLOBS_TEE
	string "Rockchip OP-TEE (BL32) file"
	help
	  OP-TEE blob for Rockchip BL31 builds that use the OP-TEED SPD.
	  Required when the ATF blob expects BL32 (e.g. rk3576_bl31_v1.24.elf).

endif
```
