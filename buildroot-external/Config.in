## buildroot-external/package/rockchip-mali-sdk/Config.in
```kconfig
config BR2_PACKAGE_ROCKCHIP_MALI_SDK
	bool "rockchip-mali-sdk"
	depends on BR2_aarch64
	select BR2_PACKAGE_HAS_LIBEGL
	select BR2_PACKAGE_HAS_LIBGLES
	select BR2_PACKAGE_HAS_LIBGBM
	select BR2_PACKAGE_HAS_LIBOPENCL
	select BR2_PACKAGE_LIBDRM
	help
	  Rockchip Mali GPU driver library (SDK version).
	  This package provides the Mali GPU driver for Rockchip SoCs,
	  supporting OpenGL ES, OpenCL, and Vulkan.
	  This is the SDK-specific version for RK3576 Mali G52.

	  https://github.com/rockchip-linux/libmali

if BR2_PACKAGE_ROCKCHIP_MALI_SDK

config BR2_PACKAGE_PROVIDES_LIBEGL
	string
	default "rockchip-mali-sdk"

config BR2_PACKAGE_PROVIDES_LIBGLES
	string
	default "rockchip-mali-sdk"

config BR2_PACKAGE_PROVIDES_LIBGBM
	string
	default "rockchip-mali-sdk"

config BR2_PACKAGE_PROVIDES_LIBOPENCL
	string
	default "rockchip-mali-sdk"

config BR2_PACKAGE_ROCKCHIP_MALI_SDK_HAS_EGL
	bool "EGL support"
	default y

config BR2_PACKAGE_ROCKCHIP_MALI_SDK_HAS_GLES
	bool "OpenGL ES support"
	default y

config BR2_PACKAGE_ROCKCHIP_MALI_SDK_HAS_OPENCL
	bool "OpenCL support"
	default y

config BR2_PACKAGE_ROCKCHIP_MALI_SDK_HAS_VULKAN
	bool "Vulkan support"

config BR2_PACKAGE_ROCKCHIP_MALI_SDK_HAS_GBM
	bool "GBM support"
	default y

config BR2_PACKAGE_ROCKCHIP_MALI_SDK_HAS_X11
	bool "X11 support"

config BR2_PACKAGE_ROCKCHIP_MALI_SDK_HAS_WAYLAND
	bool "Wayland support"

config BR2_PACKAGE_ROCKCHIP_MALI_SDK_HAS_DUMMY
	bool "Dummy platform support"

config BR2_PACKAGE_ROCKCHIP_MALI_SDK_CUSTOM_PLATFORM
	string "Custom platform string"
	default ""

endif

comment "rockchip-mali-sdk needs an aarch64 toolchain"
	depends on !BR2_aarch64
```

## buildroot-external/package/rockchip-mpp/Config.in
```kconfig
menuconfig BR2_PACKAGE_ROCKCHIP_MPP
	bool "rockchip-mpp"
	select BR2_PACKAGE_LIBDRM
	help
	  Rockchip MPP (Multimedia Processing Platform) library.
	  MPP provides hardware-accelerated video encoding and decoding
	  for Rockchip SoCs (RK3576, RK3588, etc.).

	  https://github.com/rockchip-linux/mpp

	config BR2_PACKAGE_ROCKCHIP_MPP_ALLOCATOR_DRM
		bool "DRM allocator"
		default y
		help
		  Enable DRM allocator support for buffer management.

	config BR2_PACKAGE_ROCKCHIP_MPP_TESTS
		bool "test programs"
		default n
		help
		  Build and install the MPP test programs.
```

## buildroot-external/package/rockchip-pack/Config.in.host
```kconfig
config BR2_PACKAGE_HOST_ROCKCHIP_PACK
	bool "rockchip pack tools (afptool, rkImageMaker, boot_merger)"
	help
	  Host utilities to build Rockchip update.img firmware packages.
	  Required for Neardi LB200 (parameter-ab layout).

	  Vendored from Rockchip Linux SDK tooling and rkbin.
```

## buildroot-external/package/rockchip-recovery/Config.in
```kconfig
config BR2_PACKAGE_ROCKCHIP_RECOVERY
	bool "Rockchip recovery / updateEngine (Linux)"
	depends on BR2_TOOLCHAIN_HAS_THREADS
	select BR2_PACKAGE_LIBPTHREAD_STUBS
	select BR2_PACKAGE_UTIL_LINUX
	select BR2_PACKAGE_LIBCURL
	select BR2_PACKAGE_BZIP2
	select BR2_PACKAGE_OPENSSL
	help
	  Rockchip updateEngine and A/B boot control for Linux.
	  Sources are vendored under package/rockchip-recovery/src.

if BR2_PACKAGE_ROCKCHIP_RECOVERY

config BR2_PACKAGE_ROCKCHIP_RECOVERY_BOOTCONTROL
	bool "Linux A/B boot control (updateEngine --misc=now)"
	default y

config BR2_PACKAGE_ROCKCHIP_RECOVERY_UPDATEENGINE
	bool "updateEngine binary"
	default y

config BR2_PACKAGE_ROCKCHIP_RECOVERY_SUCCESSFUL_BOOT
	bool "successful_boot A/B slot marking"
	default y

endif
```

## buildroot-external/package/rockchip-rga/Config.in
```kconfig
config BR2_PACKAGE_ROCKCHIP_RGA
	bool "rockchip-rga"
	select BR2_PACKAGE_LIBDRM
	help
	  Rockchip RGA (Raster Graphic Acceleration) library.
	  RGA provides hardware-accelerated image processing operations
	  such as scaling, rotation, color conversion, and blending.

	  https://github.com/rockchip-linux/linux-rga
```

## buildroot-external/package/skwifi/Config.in
```kconfig
config BR2_PACKAGE_SKWIFI
    bool "skwifi - Seekwave WiFi/BT driver"
    help
      Seekwave SV6160 WiFi/BT driver for Rockchip platforms.

      This package provides the SKW (Seekwave) WiFi and Bluetooth
      driver for SV6160/SWT6652 modules commonly used on Rockchip
      based boards.

      Note: This driver requires kernel 6.1 or later with cfg80211
      and mac80211 support.

comment "skwifi needs a Linux kernel to be built"
    depends on !BR2_LINUX_KERNEL

if BR2_PACKAGE_SKWIFI

# SKW WiFi firmware files
config BR2_PACKAGE_SKWIFI_FIRMWARE
    bool "Include SKW firmware files"
    default y
    help
      Include SKW WiFi/BT firmware files in the rootfs.
      These files are required for the WiFi module to operate.

endif
```

## buildroot-external/package/tempio/Config.in.host
```kconfig
config BR2_PACKAGE_HOST_TEMPIO
	bool "Muthur Command OS tempio (host)"
	depends on BR2_PACKAGE_HOST_GO_HOST_ARCH_SUPPORTS
	help
	  Install the Muthur Command OS tempio template helper
	  (Go text/template + sprig).
```
